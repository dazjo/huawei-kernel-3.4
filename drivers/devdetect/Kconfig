## drivers/devdetect/Kconfig
```kconfig
#
# I2C devices detect
#

config HUAWEI_HW_DEV_DCT
	bool "HUAWEI DEVICE DETECT"
	depends on HUAWEI_KERNEL = y
	default n
	help
		Say yes if you want i2c device detect driver.
		This is for i2c connected version. If unsure, say N here.
```

## drivers/i2c/chips/Kconfig
```kconfig
#
# Miscellaneous I2C chip drivers configuration
#
# *** DEPRECATED! Do not add new entries! See Makefile ***
#

menu "Miscellaneous I2C Chip support"

config SENSORS_MT9T013
	tristate "MT9T013 Camera Driver"
	depends on I2C
	default y
	help
	 MT9T013 Camera Driver implemented by HTC.

config HUAWEI_FEATURE_TPA2028D1_AMPLIFIER
	tristate "tpa2028d1 amplifier"
	depends on HUAWEI_KERNEL
	default y
	help
	 tpa2028d1 amplifier used for audio.

config HUAWEI_FEATURE_SENSORS_ST_LSM303DLH
	tristate "LSM303DLH is a 6D sensors(gs&ms)"
	depends on HUAWEI_KERNEL
	default n
	help
	 The LSM303DLH is a system-in-package featuring a 3D
	 digital linear acceleration sensor and a 3D digital magnetic sensor.
config HUAWEI_FEATURE_SENSORS_AK8975
	tristate "AK8975"
	depends on HUAWEI_KERNEL
	default n
	help
	  If you say yes here you get support for Asahi Kasei's 
	  orientation sensor AK8975.
config QWERTY_KEYPAD_ADP5587
	tristate "Qwerty Keypad Controller Driver"
	depends on HUAWEI_KERNEL
	default n
	help
	 Driver for Qwerty Keypad Controller Driver.
config HUAWEI_FEATURE_SENSORS_AK8963
	tristate "AK8963 compass support"
	default n
	help
	  If you say yes here you get support for Asahi Kasei's
	  orientation sensor AK8963.
endmenu
```

## drivers/i2c/gyroscope/Kconfig
```kconfig
#
# gyroscope driver configuration
#

config HUAWEI_FEATURE_GYROSCOPE_L3G4200DH
	tristate "L3G4200DH"
	depends on HUAWEI_KERNEL	
	default n 
	help
	  Say Y here if you have the ST L3G4200DH gyroscope.
```

## drivers/input/accelerometer/Kconfig
```kconfig
#
# accelerometer driver configuration
#
menuconfig HUAWEI_FEATURE_INPUT_ACCELEROMETER
	bool "Accelerometer"
	depends on HUAWEI_KERNEL = y
	default n 
	help
	  Say Y here, and a list of supported ACCELEROMETERs will be displayed.
	  This option doesn't affect the kernel.

	 
#/*delete select SERIO*/
if HUAWEI_FEATURE_INPUT_ACCELEROMETER

config HUAWEI_FEATURE_ACCELEROMETER_ADXL345
	tristate "ADI ADXL345 accelerometer"	
	depends on HUAWEI_KERNEL = y
	default n 
	help
	  Say Y here if you have the ADXL345 accelerometer.

	  
config HUAWEI_FEATURE_ACCELEROMETER_ST_L1S35DE
	tristate "ST LIS35DE accelerometer"	
	depends on HUAWEI_KERNEL = y
	default n 
	help
	  Say Y here if you have the ST LIS35DE accelerometer.
config HUAWEI_FEATURE_SENSORS_ACCELEROMETER_MMA8452
	tristate "FREESCALE MMA8452 accelerometer"
	default n 
	help
	  Say Y here if you have the FREESCALE MMA8452 accelerometer.

config HUAWEI_FEATURE_SENSORS_ACCELEROMETER_BOSCH_BMA250
	tristate "BOSCH BMA250 accelerometer"
	default n 
	help
	  Say Y here if you have the BOSCH BMA250 accelerometer.
config HUAWEI_FEATURE_SENSORS_ACCELEROMETER_ADI_ADXL346
	tristate "ADI ADXL346 accelerometer"
	default n 
	help
	  Say Y here if you have the ADI ADXL346 accelerometer.

config HUAWEI_FEATURE_SENSORS_ACCELEROMETER_ST_LIS3XH
	tristate "ST LIS3DH and LIS331DLH accelerometer"	
	default n 
	help
	  Say Y here if you have the ST LIS3DH and LIS331DLH accelerometer.
config HUAWEI_FEATURE_SENSORS_ACCELEROMETER_KXTIK1004
	tristate "KXTIK-1004 accelerometer"	
	help
	  Say Y here if you have the KXTIK-1004 accelerometer.
endif
```

## drivers/media/video/msm/Kconfig
```kconfig
config MSM_CAMERA_V4L2
        bool "MSM Camera V4L2 Interface"
        depends on MSM_CAMERA
        default n
        ---help---
          This flag enables V4L2 interface of MSM
          camera driver. If enabled, application interacts
          with /dev/video0 through V4L2 APIs. Otherwise,
          native APIs are used through /dev/config0, /dev/frame0,
          and /dev/control0.

comment "Camera Sensor Selection"
config HUAWEI_CAMERA
	bool "HUAWEI_CAMERA "
	depends on MSM_CAMERA && !ARCH_MSM8X60 && !ARCH_MSM8960 && !MSM_CAMERA_V4L2
	default n
	---help---
	  Huawei Camera 
config HUAWEI_CAMERA_SENSOR_S5K5CA
	tristate "s5k5ca is used"
	default n
	help
	if Y ,select HUAWEI_CAMERA_SENSOR_S5K5CA
config HUAWEI_CAMERA_SENSOR_MT9T113
	tristate "mt9t113 is used"
	default n
	help
	if Y ,select HUAWEI_CAMERA_SENSOR_MT9T113
config MT9T013
	bool "Sensor mt9t013 (BAYER 3M)"
	depends on MSM_CAMERA && !ARCH_MSM8X60 && !ARCH_MSM8960 && !MSM_CAMERA_V4L2
	default y
	---help---
	  MICRON 3M Bayer Sensor with AutoFocus
config HUAWEI_CAMERA_SENSOR_MT9D113
	bool "Sensor mt9d113 (YUV 2M)"
	default n
	---help---
	  MICRON 2M YUV Sensor
	  This sensor is the front camera on QT8660.
	  This uses csi mipi interface.
	  This sensor is used only on QT device.
config HUAWEI_CAMERA_SENSOR_MT9V113
	tristate "mt9v113 is used"
	default n
	help
	if Y ,select HUAWEI_CAMERA_SENSOR_MT9V113
config HUAWEI_CAMERA_SENSOR_GC0313
	tristate "gc0313 is used"
	default n
	help
	if Y ,select HUAWEI_CAMERA_SENSOR_GC0313
config HUAWEI_CAMERA_SENSOR_BF3905
	tristate "bf3905 is used"
	default n
	help
	if Y ,select HUAWEI_CAMERA_SENSOR_BF3905
config MT9D112
	bool "Sensor mt9d112 (YUV 2M)"
	depends on MSM_CAMERA && !ARCH_MSM8X60 && !ARCH_MSM8960 && !MSM_CAMERA_V4L2
	default y
	---help---
	  MICRON 2M YUV Sensor
config  HUAWEI_CAMERA
	bool "Select huawei camera"
	depends on MSM_CAMERA
	depends on HUAWEI_KERNEL
	default n
	---help---
	  Select huawei camera

config HUAWEI_SENSOR_HI701
	bool "Sensor Hynix (YUV 30W)"
	depends on HUAWEI_CAMERA
	default n
	---help---
	  Hynix 30w YUV Sensor

config HUAWEI_SENSOR_OV7690
	bool "Sensor ov7690 (YUV 30K)"
	depends on HUAWEI_CAMERA
	default n
	---help---
	  MICRON 30k YUV Sensor


config HUAWEI_SENSOR_OV7736
	bool "Sensor ov7736 (YUV 30W)"
	depends on HUAWEI_CAMERA
	default n
	---help---
	  MICRON 30W YUV Sensor
	  
config HUAWEI_SENSOR_HIMAX0356
	bool "Sensor himax (YUV 30W)"
	depends on HUAWEI_CAMERA
	default n
	---help---
	  HIMAX 30w YUV Sensor

config HUAWEI_SENSOR_MT9D113
	bool "Sensor Aptina (YUV 200W)"
	depends on HUAWEI_CAMERA
	default n
	---help---
	  Aptina 200w YUV Sensor

config HUAWEI_SENSOR_MT9V114
	bool "Sensor Aptina (YUV 30W)"
	depends on HUAWEI_CAMERA
	default n
	---help---
	  Aptina 30w YUV Sensor
	  
#/* delte macro CONFIG_HUAWEI_SENSOR_S5K4E1GX*/
config HUAWEI_SENSOR_MT9P017
	bool "Sensor mt9p017 (BAYER 5M)"
	depends on HUAWEI_CAMERA
	default n
	---help---
	  Sunny 5M Bayer Sensor with AutoFocus
	  	  
	  
config HUAWEI_SENSOR_OV5647_SUNNY
	bool "Sensor ov5647_sunny (BAYER 5M)"
	depends on HUAWEI_CAMERA
	default n
	---help---
	  MICRON 5M Bayer Sensor with AutoFocus
config HUAWEI_FEATURE_RIGHT_TPA2028D1_AMPLIFIER
	tristate "right tpa2028d1 amplifier"
	depends on HUAWEI_KERNEL
	default y
	---help---
	  tpa2028d1 amplifier used for audio.
config IMX074
	bool "Sensor IMX074 (BAYER 13.5M)"
	depends on MSM_CAMERA
	---help---
	SONY 13.5 MP Bayer Sensor
config OV5640
	bool "Sensor OV5640 (YUV 5M)"
	depends on MSM_CAMERA && !MSM_CAMERA_V4L2
	default n
	---help---
	Omni 5M YUV Sensor

config OV5647
	bool "Sensor ov5647 (BAYER 5M)"
	depends on MSM_CAMERA
	---help---
	  OV 5M Bayer Sensor with AutoFocus

config AD5046_ACT
	bool "Lens actuator ad5046"
	depends on MSM_CAMERA && OV5647
	---help---
	  ad5046 lens actuator driver for ov5647.
	  Say Y here if this is msm7627A variant platform.
config WEBCAM_OV7692_QRD
	bool "Sensor OV7692 QRD(VGA YUV)"
	depends on MSM_CAMERA && (ARCH_MSM7X27A || ARCH_MSM8X60)
	default n
	---help---
	  Omni Vision VGA YUV Sensor for QRD Devices
config MT9M114
        bool "Sensor MT9M114 (YUV 1.26M)"
        depends on MSM_CAMERA
        ---help---
        APTINA 1.26 MP yuv Sensor
config WEBCAM_OV7692
	bool "Sensor OV7692 (VGA YUV)"
	depends on MSM_CAMERA && ARCH_MSM8X60 && !MSM_CAMERA_V4L2
	default y
	---help---
	  Omni Vision VGA YUV Sensor.
config WEBCAM_OV9726
	bool "Sensor OV9726 (VGA Bayer)"
	depends on MSM_CAMERA && (ARCH_MSM8X60 || ARCH_MSM7X30 || ARCH_MSM7X27A)
	default n
	---help---
	  Omni Vision VGA Bayer Sensor.
#	This Senosr is used as a webcam.
#	This uses the CSI interface.
config VX6953
	bool "Sensor VX6953 (BAYER 5M)"
	depends on MSM_CAMERA && (ARCH_MSM7X30 || ARCH_MSM8X60) && !MSM_CAMERA_V4L2
	default y
	---help---
	STM 5M Bayer Sensor with EDOF
config SN12M0PZ
	bool "Sensor sn12m0pz (Bayer 12 MP)"
	depends on MSM_CAMERA && ARCH_MSM7X30 && !MSM_CAMERA_V4L2
	default y
	---help---
	  Sony 12 MP Bayer Sensor
config MT9P012
	bool "Sensor mt9p012 (BAYER 5M)"
	depends on MSM_CAMERA && !ARCH_MSM8X60 && !MSM_CAMERA_V4L2
	default y
	---help---
	  MICRON 5M Bayer Sensor with Autofocus

choice
	prompt "AF module"
	depends on MT9P012 && !ARCH_MSM8X60 && !MSM_CAMERA_V4L2
	default MSM_CAMERA_AF_FOXCONN

config MSM_CAMERA_AF_FOXCONN
	bool "FOXCONN Module"
	help
	  This driver supports FOXCONN AF module for 5M Bayer sensor

config MSM_CAMERA_AF_BAM
	bool "BAM Module"
	help
	  This driver supports BAM AF module for 5M Bayer sensor

endchoice

config MT9P012_KM
	bool "Sensor mt9p012 KM module (BAYER 5M)"
	depends on MSM_CAMERA && !ARCH_MSM8X60 && !MSM_CAMERA_V4L2
	default y
	---help---
	  MICRON 5M Bayer Sensor KM modules with Autofocus

config MT9E013
	bool "Sensor mt9e013 module (BAYER 8M)"
	depends on MSM_CAMERA && (ARCH_MSM7X30 || ARCH_MSM8X60 || ARCH_MSM7X27A)
	default n
	---help---
	  Aptina 8M Bayer Sensor modules with Autofocus

config HUAWEI_SENSOR_MT9E013
	bool "Sensor mt9e013 module (BAYER 8M)"
	depends on HUAWEI_CAMERA
	default y
	---help---
	  Aptina 8M Bayer Sensor modules with Autofocus

config IMX074_ACT
	bool "Actuator IMX074 (BAYER 13.5M)"
	depends on MSM_CAMERA
	---help---
	Actuator for SONY 13.5 MP Bayer Sensor

config S5K3E2FX
	bool "Sensor s5k3e2fx (Samsung 5M)"
	depends on MSM_CAMERA && !ARCH_MSM8X60 && !MSM_CAMERA_V4L2
	default y
	---help---
	  Samsung 5M with Autofocus

config QS_S5K4E1
	bool "Sensor qs_s5k4e1 (Samsung 5M)"
	depends on MSM_CAMERA && ARCH_MSM8X60 && !MSM_CAMERA_V4L2
	default y
	---help---
	  Samsung 5M with Autofocus

config HUAWEI_SENSOR_S5K4E1
	bool "Sensor Sensor s5k4e1 (Samsung 5M)"
	depends on MSM_CAMERA
	default n
	---help---
	  Support for S5k4E1 samsung sensor driver.
	  It is a Bayer 5MP sensor with auto focus and it supports
	  two mipi lanes, required for msm7x2xA platform.
	  Say Y here if this is msm7x2xA variant platform.
config HUAWEI_CAMERA_SENSOR_IMX105
	bool "Sensor imx105 (SUNNY 8M)"
	depends on MSM_CAMERA
	default n
	---help---
	  Support for IMX105 sunnsy sensor driver.
	  It is a Bayer 8MP sensor with auto focus and it supports
	  two mipi lanes, required for msm7x2xA platform.
	  Say Y here if this is msm7x2xA variant platform.
config HUAWEI_CAMERA_SENSOR_S5K3H2
	bool "Sensor sk53h2 (LITEON 8M)"
	depends on MSM_CAMERA
	default n
	---help---
	  Support for S5K3H2 sunnsy sensor driver.
	  It is a Bayer 8MP sensor with auto focus and it supports
	  two mipi lanes, required for msm7x2xA platform.
	  Say Y here if this is msm7x2xA variant platform.
config HUAWEI_CAMERA_SENSOR_HI542
	bool "Sensor hi542 (SUNNY 5M)"
	depends on MSM_CAMERA
	default n
	---help---
	  Support for HI542 sunny sensor driver.
	  It is a Bayer 5MP sensor without auto focus and it supports
	  two mipi lanes, required for msm8x25 platform.
	  Say Y here if this is msm8x25 variant platform.
config DW9712_ACT
	bool "Lens actuator dw9721"
	depends on MSM_CAMERA && S5K4E1
	---help---
	  dw9721 lens actuator driver for S5K4E1.
	  Say Y here if this is msm7627A variant platform.

config MSM_CAMERA_FLASH_SC628A
	bool "Qualcomm MSM camera sc628a flash support"
	depends on MSM_CAMERA
	default n
	---help---
	  Enable support for LED flash for msm camera.
	  It is a samtech charge pump flash driver and it
	  supports spotlight and flash light modes with
	  differrent current levels.

config MSM_CAMERA_FLASH_TPS61310
	bool "Qualcomm MSM camera tps61310 flash support"
	depends on MSM_CAMERA
	default n
	---help---
	  Enable support for LED flash for msm camera.
	  It is a Texas Instruments multiple LED Flash
	  for camera flash and video light applications.

config IMX072
	bool "Sensor imx072 (Sony 5M)"
	default n
	---help---
	  Support for IMX072 sony sensor driver.
	  It is a Bayer 5MP sensor with auto focus and it supports
	  two mipi lanes, required for msm7x2xA platform.
	  Say Y here if this is msm7x2xA variant platform.

config OV2720
	bool "Sensor ov2720 (Omnivision 2MP)"
	depends on MSM_CAMERA

config OV8825
	bool "Sensor ov8825 (Omnivision 8M)"
	depends on MSM_CAMERA
	---help---
	  Support for OV8825 sensor driver.
	  It is a Bayer 8MP sensor with auto focus and it supports
	  two mipi lanes, required for msm8625 platform.
	  Say Y here if this is msm8625 variant platform.

config VB6801
	bool "Sensor vb6801"
	depends on MSM_CAMERA && !ARCH_MSM8X60 && !MSM_CAMERA_V4L2
	---help---
	  5M with flash

config MSM_CAMERA_FLASH
	bool "Qualcomm MSM camera flash support"
	depends on MSM_CAMERA
	default y
	---help---
	  Enable support for LED flash for msm camera

config HUAWEI_FEATURE_TPS61310
	tristate "TPS61310"
	depends on HUAWEI_KERNEL
	default n
	help
	  tps61310 LED camera flash and video light
config HUAWEI_FEATURE_LM3642
	tristate "LM3642"
	depends on HUAWEI_KERNEL
	default n
	help
	  lm3642 LED camera flash and video light
config HW_TORCH
	bool "HUAWEI torch support"
	depends on MSM_CAMERA_FLASH
	default n
	---help---
	  Enable support for LED flash for torch

config MSM_CAMERA_SENSOR
	bool "Qualcomm MSM camera sensor support"
	depends on MSM_CAMERA

config MSM_ACTUATOR
	bool "Qualcomm MSM actuator support"
	depends on MSM_CAMERA

config MSM_EEPROM
	bool "Qualcomm MSM EEPROM support"
	depends on MSM_CAMERA

config IMX074_EEPROM
	bool "IMX074 EEPROM support"
	depends on MSM_CAMERA

config IMX091_EEPROM
	bool "IMX091 EEPROM support"
	depends on MSM_CAMERA

config MSM_GEMINI
	tristate "Qualcomm MSM Gemini Jpeg Engine support"
	depends on MSM_CAMERA && (ARCH_MSM7X30 || ARCH_MSM8X60 || ARCH_MSM8960)
	default n
	---help---
	  Enable support for Gemini Jpeg Engine

config MSM_VPE
	tristate "Qualcomm MSM Video Pre-processing Engine support"
	depends on MSM_CAMERA && (ARCH_MSM7X30 || ARCH_MSM8X60)
	default y
	---help---
	  Enable support for Video Pre-processing Engine

config QUP_EXCLUSIVE_TO_CAMERA
	bool "QUP exclusive to camera"
	depends on MSM_CAMERA
	default y
	---help---
	  This flag enabled states that QUP
	  is exclusive to camera. In case this
	  is disabled, the lvs1 voltage is enabled
	  by QUP in the board file as QUP is used by
	  applications other than camera.

config S5K3L1YX
	bool "Sensor S5K3L1YX (BAYER 12M)"
	depends on MSM_CAMERA
	---help---
		Samsung 12 MP Bayer Sensor with auto focus, uses
		4 mipi lanes, preview config = 1984 * 1508 at 30 fps,
		snapshot config = 4000 * 3000 at 20 fps,
		hfr video at 60, 90 and 120 fps.

config IMX091
        bool "Sensor imx091 (Sony 13MP)"
        depends on MSM_CAMERA
	---help---
	  Sony 13MP sensor back camera that uses 4 mipi lanes,
	  runs at 30 fps preview and 14 fps snapshot

config MSM_V4L2_VIDEO_OVERLAY_DEVICE
	tristate "Qualcomm MSM V4l2 video overlay device"
	---help---
	  Enables support for the MSM V4L2 video
	  overlay driver. This allows video rendering
	  apps to render overlaid video using Video4Linux2
	  APIs, by using /dev/videoX device

config OV7692
	bool "Sensor OV7692 (VGA YUV)"
	depends on MSM_CAMERA
	---help---
	  Omni Vision VGA YUV Sensor
```

## drivers/staging/rsm/Kconfig
```kconfig
#
# RSM configuration.
#

config HUAWEI_HUNGTASK
	tristate "Huawei RSM module support"
	depends on !DETECT_HUNG_TASK
	default n
	---help---
	  If you say M here you open RSM as an insertable module.
	  This module check proccess in D status periodly(the period can be defined by user),
	  except some proccess(these proccesses not be checked is also defined by user), 
	  if [ nvcsw + nivcsw ] in task_struct is equal to last switch count,
	  RSM module will treat it as a proccess in deadlock.
	  
```
